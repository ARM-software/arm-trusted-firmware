/*
 * Copyright (c) 2019-2020, Arm Limited. All rights reserved.
 *
 * SPDX-License-Identifier: BSD-3-Clause
 */

/dts-v1/;

/ {
	/* Platform Config */
	plat_arm_bl2 {
		compatible = "arm,tb_fw";
		hw_config_addr = <0x0 0x83000000>;
		hw_config_max_size = <0x01000000>;
		/* Disable authentication for development */
		disable_auth = <0x0>;
	};
};

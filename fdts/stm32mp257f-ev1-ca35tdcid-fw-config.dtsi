// SPDX-License-Identifier: (GPL-2.0-only OR BSD-3-Clause)
/*
 * Copyright (C) STMicroelectronics 2024 - All Rights Reserved
 */

/*
 * STM32MP25 tf-a firmware config
 * Project : open
 * Generated by XLmx tool version 2.2 - 2/27/2024 11:46:17 AM
 */

/ {
	dtb-registry {
		soc_fw-config {
			load-address = <0x0 0x81ff0000>;
			max-size = <0x10000>;
		};
		tos_fw {
			load-address = <0x0 0x82000000>;
			max-size = <0x2000000>;
		};
	};
};

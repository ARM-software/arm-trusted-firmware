/*
 * Copyright (c) 2018-2020, ARM Limited and Contributors. All rights reserved.
 *
 * SPDX-License-Identifier: BSD-3-Clause
 */

/* DynamIQ configuration: 1 cluster with up to 8 CPUs */

/* Set default value if not passed from platform's makefile */
#ifdef	FVP_MAX_PE_PER_CPU
#define	PE_PER_CPU		FVP_MAX_PE_PER_CPU
#else
#define	PE_PER_CPU		1
#endif

#include "fvp-defs-dynamiq.dtsi"

/dts-v1/;

/memreserve/ 0x80000000 0x00010000;

#include "fvp-base-gicv3.dtsi"
#include "fvp-base-psci-common.dtsi"

// SPDX-License-Identifier: GPL-2.0 OR BSD-3-Clause
/*
 * Copyright (C) Linaro Ltd 2019 - All Rights Reserved
 * Author: Manivannan Sadhasivam <manivannan.sadhasivam@linaro.org>
 * Copyright (C) 2020 Marek Vasut <marex@denx.de>
 * Copyright (C) 2022 DH electronics GmbH
 *
 * DHCOR STM32MP1 variant:
 * DHCR-STM32MP157A-C065-R102-V18-SPI-C-01LG
 * DHCOR PCB number: 586-100 or newer
 * Avenger96 PCB number: 588-200 or newer
 */

/dts-v1/;

#include "stm32mp157.dtsi"
#include "stm32mp15xx-dhcor-som.dtsi"
#include "stm32mp15xx-dhcor-avenger96.dtsi"

/ {
	model = "Arrow Electronics STM32MP157A Avenger96 board";
	compatible = "arrow,stm32mp157a-avenger96", "dh,stm32mp157a-dhcor-som",
		     "st,stm32mp157";
};

/*
 * Copyright (c) 2018-2019, Arm Limited. All rights reserved.
 *
 * SPDX-License-Identifier: BSD-3-Clause
 */

/dts-v1/;
/ {
	/* compatible string */
	compatible = "arm,rd-e1edge";

	/*
	 * Place holder for system-id node with default values. The
	 * value of platform-id and config-id will be set to the
	 * correct values during the BL2 stage of boot.
	 */
	system-id {
		platform-id = <0x0>;
		config-id = <0x0>;
	};

};

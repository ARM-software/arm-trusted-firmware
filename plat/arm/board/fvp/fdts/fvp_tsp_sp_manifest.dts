/*
 * Copyright (c) 2022, Arm Limited. All rights reserved.
 *
 * SPDX-License-Identifier: BSD-3-Clause
 */
/dts-v1/;

#define	AFF	00

#include "fvp-defs.dtsi"
#undef POST
#define	POST \
	};

#define S_EL0	(0x1)
#define S_EL1	(0x2)

/* For consumption by EL3 SPMC. */
/ {
	compatible = "arm,ffa-manifest-1.0";
	#address-cells = <2>;
	#size-cells = <1>;

	ffa-version = <0x00010001>; /* 31:16 - Major, 15:0 - Minor */
	id = <0x8001>;
	uuid = <0x6b43b460 0x74a24b78 0xade24502 0x40682886>;
	messaging-method = <0x3>; /* Direct Messaging Only */
	exception-level = <S_EL1>;
	execution-state = <0>;
	execution-ctx-count = <8>;
	gp-register-num = <0>;
	/* Subscribe to CPU_OFF, CPU_SUSPEND and CPU_SUSPEND_RESUME PM Msgs */
	power-management-messages = <0x7>;
};

// SPDX-License-Identifier: (GPL-2.0+ OR BSD-3-Clause)
/*
 * Copyright (c) 2023, Oleksij Rempel <kernel@pengutronix.de>, Pengutronix
 */

#define DDR_SIZE	0x10000000 /* 256 MB */
#include "stm32mp15-fw-config.dtsi"

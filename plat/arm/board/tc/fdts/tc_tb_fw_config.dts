/*
 * Copyright (c) 2020-2021, Arm Limited. All rights reserved.
 *
 * SPDX-License-Identifier: BSD-3-Clause
 */

#include <lib/libc/cdefs.h>

/dts-v1/;

/ {
	tb_fw-config {
		compatible = "arm,tb_fw";

		/* Disable authentication for development */
		disable_auth = <0x0>;
		/*
		 * The following two entries are placeholders for Mbed TLS
		 * heap information. The default values don't matter since
		 * they will be overwritten by BL1.
		 * In case of having shared Mbed TLS heap between BL1 and BL2,
		 * BL1 will populate these two properties with the respective
		 * info about the shared heap. This info will be available for
		 * BL2 in order to locate and re-use the heap.
		 */
		mbedtls_heap_addr = <0x0 0x0>;
		mbedtls_heap_size = <0x0>;
	};

	secure-partitions {
		compatible = "arm,sp";
#ifdef ARM_BL2_SP_LIST_DTS
	#include __XSTRING(ARM_BL2_SP_LIST_DTS)
#else
#ifdef TS_SP_FW_CONFIG
		internal-trusted-storage {
		       uuid = "dc1eef48-b17a-4ccf-ac8b-dfcff7711b14";
		       load-address = <0xfee00000>;
		};
		crypto {
		       uuid = "d9df52d5-16a2-4bb2-9aa4-d26d3b84e8c0";
		       load-address = <0xfec00000>;
		};
#endif
#if OPTEE_SP_FW_CONFIG
		op-tee {
		       uuid = "486178e0-e7f8-11e3-bc5e-0002a5d5c51b";
		       load-address = <0xfd280000>;
		};
#else
		cactus-primary {
			uuid = "b4b5671e-4a90-4fe1-b81f-fb13dae1dacb";
			load-address = <0xfe000000>;
			owner = "SiP";
		};

		cactus-secondary {
			uuid = "d1582309-f023-47b9-827c-4464f5578fc8";
			load-address = <0xfe100000>;
			owner = "Plat";
		};

		cactus-tertiary {
			uuid = "79b55c73-1d8c-44b9-8593-61e1770ad8d2";
			load-address = <0xfe200000>;
		};

		ivy {
			uuid = "eaba83d8-baaf-4eaf-8144-f7fdcbe544a7";
			load-address = <0xfe600000>;
			owner = "Plat";
		};
#endif
#endif /* ARM_BL2_SP_LIST_DTS */
	};
};

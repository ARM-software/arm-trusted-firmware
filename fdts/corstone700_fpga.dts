/*
 * Copyright (c) 2020, Arm Limited. All rights reserved.
 *
 * SPDX-License-Identifier: BSD-3-Clause
 */

/dts-v1/;

#include "corstone700.dtsi"

/ {
	model = "corstone700-fpga";

	ethernet: eth@40100000 {
		compatible = "smsc,lan9115";
		reg = <0x40100000 0x10000>;
		phy-mode = "mii";
		interrupt-parent = <&gic>;
		interrupts = <GIC_SPI 116 IRQ_TYPE_LEVEL_HIGH>;
		reg-io-width = <2>;
		smsc,irq-push-pull;
	};

	usb: usb@4020000 {
		compatible = "nxp,usb-isp1763";
		reg = <0x40200000 0x100000>;
		interrupt-parent = <&gic>;
		interrupts = <GIC_SPI 114 IRQ_TYPE_LEVEL_HIGH>;
	};
};

&refclk {
	clock-frequency = <32000000>;
};

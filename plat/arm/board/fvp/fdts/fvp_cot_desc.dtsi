/*
 * Copyright (c) 2024-2025, Arm Limited. All rights reserved.
 *
 * SPDX-License-Identifier: BSD-3-Clause
 */


#if COT_DESC_IN_DTB
	#if defined(ARM_COT_cca)
		#include "cca_cot_descriptors.dts"
	#elif defined(ARM_COT_dualroot)
		#include "dualroot_cot_descriptors.dts"
	#elif defined(ARM_COT_tbbr)
		#include "tbbr_cot_descriptors.dts"
	#endif
#endif

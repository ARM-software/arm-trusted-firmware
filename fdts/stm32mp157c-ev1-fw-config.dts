// SPDX-License-Identifier: (GPL-2.0+ OR BSD-3-Clause)
/*
 * Copyright (c) 2020-2021, STMicroelectronics - All Rights Reserved
 */

#define DDR_SIZE	0x40000000 /* 1GB */
#include "stm32mp15-fw-config.dtsi"

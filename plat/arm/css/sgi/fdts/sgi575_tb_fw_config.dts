/*
 * Copyright (c) 2018, ARM Limited and Contributors. All rights reserved.
 *
 * SPDX-License-Identifier: BSD-3-Clause
 */

/dts-v1/;

/ {
	/* Platform Config */
	compatible = "arm,tb_fw";
	hw_config_addr = <0x0 0xFEF00000>;
	hw_config_max_size = <0x0100000>;
};

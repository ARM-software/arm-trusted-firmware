/*
 * Copyright (c) 2019-2020, Arm Limited. All rights reserved.
 *
 * SPDX-License-Identifier: BSD-3-Clause
 */

/* DynamIQ configuration: 1 cluster with up to 8 CPUs with 2 threads per each */

/* Set default value if not passed from platform's makefile */
#ifdef	FVP_MAX_PE_PER_CPU
#define	PE_PER_CPU		FVP_MAX_PE_PER_CPU
#else
#define	PE_PER_CPU		2
#endif

/dts-v1/;

#include "fvp-base-gicv3-psci-dynamiq-common.dtsi"

/*
 * Copyright (c) 2013-2021, ARM Limited and Contributors. All rights reserved.
 *
 * SPDX-License-Identifier: BSD-3-Clause
 */

/* Configuration: max 4 clusters with up to 4 CPUs */

#define	AFF

#include "fvp-defs.dtsi"

/dts-v1/;

/memreserve/ 0x80000000 0x00010000;

#include "fvp-base-gicv2.dtsi"
#include "fvp-base-psci-common.dtsi"

/*
 * Copyright (c) 2020, ARM Limited and Contributors. All rights reserved.
 *
 * SPDX-License-Identifier: BSD-3-Clause
 */

/dts-v1/;
/ {
	/* compatible string */
	compatible = "arm,rd-v1-mc";

	/*
	 * Place holder for system-id node with default values. The
	 * value of platform-id and config-id will be set to the
	 * correct values during the BL2 stage of boot.
	 */
	system-id {
		platform-id = <0x0>;
		config-id = <0x0>;
		multi-chip-mode = <0x0>;
	};
};

/*
 * Copyright (c) 2020-2024, Arm Limited. All rights reserved.
 *
 * SPDX-License-Identifier: BSD-3-Clause
 */
/dts-v1/;

#include <tc_spmc_manifest.dtsi>
#include <tc_spmc_common_sp_manifest.dtsi>

&hafnium {
	vm1 {
		debug_name = "op-tee";
		load_address = <0xfd280000>;
		mem_size = <0xb00000>; /* 11MB TZC DRAM */
	};
};

/*
 * Copyright (c) 2022 Arm Limited. All rights reserved.
 *
 * SPDX-License-Identifier: BSD-3-Clause
 */
/dts-v1/;

/ {
	compatible = "arm,ffa-core-manifest-1.0";
	#address-cells = <2>;
	#size-cells = <1>;

	/*
	 * BL32 image details needed by SPMC
	 *
	 * Note:
	 * binary_size: size of BL32 + TOS_FW_CONFIG
	 */

	attribute {
		spmc_id = <0x8000>;
		maj_ver = <0x1>;
		min_ver = <0x0>;
		exec_state = <0x0>;
		load_address = <0x0 0x08000000>;
		entrypoint = <0x0 0x08000000>;
		binary_size = <0x2000000>;
	};

};

/*
 * Copyright (c) 2018-2020, ARM Limited and Contributors. All rights reserved.
 *
 * SPDX-License-Identifier: BSD-3-Clause
 */

/dts-v1/;

/ {
#if MEASURED_BOOT
#include "event_log.dtsi"
#endif
};

#if MEASURED_BOOT && defined(SPD_opteed)
&event_log {
	tpm_event_log_sm_addr = <0x0 0x0>;
};
#endif
